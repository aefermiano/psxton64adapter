;Table with values for N64 analog conversion.
;
;Please notice it's in the memory program.
;I don't know if assembler will alert if program overlaps
;this table (I don't think it will), so be careful with
;long programs.
;
;It needs to start at XX00, because we only change the offset
;of the least significant byte, and we need 256 different
;addresses.
	org N64_TABLE_LOCATION
	;For values of 0x00 to 0xFF of Playstation analog, here are 
	;the correspondent - in order - of the
	;value to use for N64
	data 0xAF
	data 0xB0
	data 0xB1
	data 0xB1
	data 0xB2
	data 0xB3
	data 0xB3
	data 0xB4
	data 0xB5
	data 0xB5
	data 0xB6
	data 0xB7
	data 0xB7
	data 0xB8
	data 0xB9
	data 0xBA
	data 0xBA
	data 0xBB
	data 0xBC
	data 0xBC
	data 0xBD
	data 0xBE
	data 0xBE
	data 0xBF
	data 0xC0
	data 0xC0
	data 0xC1
	data 0xC2
	data 0xC2
	data 0xC3
	data 0xC4
	data 0xC4
	data 0xC5
	data 0xC6
	data 0xC6
	data 0xC7
	data 0xC8
	data 0xC8
	data 0xC9
	data 0xCA
	data 0xCA
	data 0xCB
	data 0xCC
	data 0xCC
	data 0xCD
	data 0xCE
	data 0xCF
	data 0xCF
	data 0xD0
	data 0xD1
	data 0xD1
	data 0xD2
	data 0xD3
	data 0xD3
	data 0xD4
	data 0xD5
	data 0xD5
	data 0xD6
	data 0xD7
	data 0xD7
	data 0xD8
	data 0xD9
	data 0xD9
	data 0xDA
	data 0xDB
	data 0xDB
	data 0xDC
	data 0xDD
	data 0xDD
	data 0xDE
	data 0xDF
	data 0xDF
	data 0xE0
	data 0xE1
	data 0xE1
	data 0xE2
	data 0xE3
	data 0xE4
	data 0xE4
	data 0xE5
	data 0xE6
	data 0xE6
	data 0xE7
	data 0xE8
	data 0xE8
	data 0xE9
	data 0xEA
	data 0xEA
	data 0xEB
	data 0xEC
	data 0xEC
	data 0xED
	data 0xEE
	data 0xEE
	data 0xEF
	data 0xF0
	data 0xF0
	data 0xF1
	data 0xF2
	data 0xF2
	data 0xF3
	data 0xF4
	data 0xF4
	data 0xF5
	data 0xF6
	data 0xF6
	data 0xF7
	data 0xF8
	data 0xF9
	data 0xF9
	data 0xFA
	data 0xFB
	data 0xFB
	data 0xFC
	data 0xFD
	data 0xFD
	data 0xFE
	data 0xFF
	data 0xFF
	data 0x00
	data 0x00
	data 0x00
	data 0x00
	data 0x00
	data 0x00
	data 0x00
	data 0x00
	data 0x00
	data 0x00
	data 0x00
	data 0x00
	data 0x00
	data 0x00
	data 0x00
	data 0x00
	data 0x00
	data 0x00
	data 0x00
	data 0x01
	data 0x01
	data 0x02
	data 0x03
	data 0x03
	data 0x04
	data 0x05
	data 0x05
	data 0x06
	data 0x07
	data 0x07
	data 0x08
	data 0x09
	data 0x0A
	data 0x0A
	data 0x0B
	data 0x0C
	data 0x0C
	data 0x0D
	data 0x0E
	data 0x0E
	data 0x0F
	data 0x10
	data 0x10
	data 0x11
	data 0x12
	data 0x12
	data 0x13
	data 0x14
	data 0x14
	data 0x15
	data 0x16
	data 0x16
	data 0x17
	data 0x18
	data 0x18
	data 0x19
	data 0x1A
	data 0x1A
	data 0x1B
	data 0x1C
	data 0x1C
	data 0x1D
	data 0x1E
	data 0x1F
	data 0x1F
	data 0x20
	data 0x21
	data 0x21
	data 0x22
	data 0x23
	data 0x23
	data 0x24
	data 0x25
	data 0x25
	data 0x26
	data 0x27
	data 0x27
	data 0x28
	data 0x29
	data 0x29
	data 0x2A
	data 0x2B
	data 0x2B
	data 0x2C
	data 0x2D
	data 0x2D
	data 0x2E
	data 0x2F
	data 0x2F
	data 0x30
	data 0x31
	data 0x31
	data 0x32
	data 0x33
	data 0x34
	data 0x34
	data 0x35
	data 0x36
	data 0x36
	data 0x37
	data 0x38
	data 0x38
	data 0x39
	data 0x3A
	data 0x3A
	data 0x3B
	data 0x3C
	data 0x3C
	data 0x3D
	data 0x3E
	data 0x3E
	data 0x3F
	data 0x40
	data 0x40
	data 0x41
	data 0x42
	data 0x42
	data 0x43
	data 0x44
	data 0x44
	data 0x45
	data 0x46
	data 0x46
	data 0x47
	data 0x48
	data 0x49
	data 0x49
	data 0x4A
	data 0x4B
	data 0x4B
	data 0x4C
	data 0x4D
	data 0x4D
	data 0x4E
	data 0x4F
	data 0x4F
	data 0x50
	end