; Copyright 2012 Antonio Fermiano
;
; This file is part of PsxToN64Adapter.
;
; PsxToN64Adapter is free software: you can redistribute it and/or modify
; it under the terms of the GNU General Public License as published by
; the Free Software Foundation, either version 3 of the License, or
; (at your option) any later version.
;
; PsxToN64Adapter is distributed in the hope that it will be useful,
; but WITHOUT ANY WARRANTY; without even the implied warranty of
; MERCHANTABILITY or FITNESS FOR A PARTICULAR PURPOSE.  See the
; GNU General Public License for more details.
;
; You should have received a copy of the GNU General Public License
; along with this program.  If not, see <https://www.gnu.org/licenses/>.

VAR2 equ 0xA0
	cblock VAR2
	;Mapping variables
	;Further description about them in the eeprom files.
	PSX_BUTTON_LEFT_CODE
	PSX_BUTTON_LEFT_POINTER
	PSX_BUTTON_LEFT_MASK
	
	PSX_BUTTON_DOWN_CODE
	PSX_BUTTON_DOWN_POINTER
	PSX_BUTTON_DOWN_MASK
	
	PSX_BUTTON_RIGHT_CODE
	PSX_BUTTON_RIGHT_POINTER
	PSX_BUTTON_RIGHT_MASK
	
	PSX_BUTTON_UP_CODE
	PSX_BUTTON_UP_POINTER
	PSX_BUTTON_UP_MASK
	
	PSX_BUTTON_START_CODE
	PSX_BUTTON_START_POINTER
	PSX_BUTTON_START_MASK
	
	PSX_BUTTON_R3_CODE
	PSX_BUTTON_R3_POINTER
	PSX_BUTTON_R3_MASK
	
	PSX_BUTTON_L3_CODE
	PSX_BUTTON_L3_POINTER
	PSX_BUTTON_L3_MASK
	
	PSX_BUTTON_SELECT_CODE
	PSX_BUTTON_SELECT_POINTER
	PSX_BUTTON_SELECT_MASK
	
	PSX_BUTTON_SQUARE_CODE
	PSX_BUTTON_SQUARE_POINTER
	PSX_BUTTON_SQUARE_MASK
	
	PSX_BUTTON_X_CODE
	PSX_BUTTON_X_POINTER
	PSX_BUTTON_X_MASK
	
	PSX_BUTTON_O_CODE
	PSX_BUTTON_O_POINTER
	PSX_BUTTON_O_MASK
	
	PSX_BUTTON_TRIANGLE_CODE
	PSX_BUTTON_TRIANGLE_POINTER
	PSX_BUTTON_TRIANGLE_MASK
	
	PSX_BUTTON_R2_CODE
	PSX_BUTTON_R2_POINTER
	PSX_BUTTON_R2_MASK
	
	PSX_BUTTON_L2_CODE
	PSX_BUTTON_L2_POINTER
	PSX_BUTTON_L2_MASK
	
	PSX_BUTTON_R1_CODE
	PSX_BUTTON_R1_POINTER
	PSX_BUTTON_R1_MASK
	
	PSX_BUTTON_L1_CODE
	PSX_BUTTON_L1_POINTER
	PSX_BUTTON_L1_MASK
	
	PSX_BUTTON_ANALOG_L_X_LEFT_CODE
	PSX_BUTTON_ANALOG_L_X_LEFT_POINTER
	PSX_BUTTON_ANALOG_L_X_LEFT_MASK
	
	PSX_BUTTON_ANALOG_L_X_RIGHT_CODE
	PSX_BUTTON_ANALOG_L_X_RIGHT_POINTER
	PSX_BUTTON_ANALOG_L_X_RIGHT_MASK
	
	PSX_BUTTON_ANALOG_L_Y_UP_CODE
	PSX_BUTTON_ANALOG_L_Y_UP_POINTER
	PSX_BUTTON_ANALOG_L_Y_UP_MASK

	PSX_BUTTON_ANALOG_L_Y_DOWN_CODE
	PSX_BUTTON_ANALOG_L_Y_DOWN_POINTER
	PSX_BUTTON_ANALOG_L_Y_DOWN_MASK
	
	PSX_BUTTON_ANALOG_R_X_LEFT_CODE
	PSX_BUTTON_ANALOG_R_X_LEFT_POINTER
	PSX_BUTTON_ANALOG_R_X_LEFT_MASK
	
	PSX_BUTTON_ANALOG_R_X_RIGHT_CODE
	PSX_BUTTON_ANALOG_R_X_RIGHT_POINTER
	PSX_BUTTON_ANALOG_R_X_RIGHT_MASK
	
	PSX_BUTTON_ANALOG_R_Y_UP_CODE
	PSX_BUTTON_ANALOG_R_Y_UP_POINTER
	PSX_BUTTON_ANALOG_R_Y_UP_MASK
	
	PSX_BUTTON_ANALOG_R_Y_DOWN_CODE
	PSX_BUTTON_ANALOG_R_Y_DOWN_POINTER
	PSX_BUTTON_ANALOG_R_Y_DOWN_MASK

	;Variables used in the conversion
	IS_BUTTON_PRESSED
	LAST_FSR
	CURRENT_CODE
	CURRENT_POINTER
	CURRENT_MASK
	
	;Temporary variable
	TEMP_BANK_2


	endc